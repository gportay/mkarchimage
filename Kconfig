## Kconfig
```kconfig
#
# Copyright (C) 2021 Gaël PORTAY
#
# SPDX-License-Identifier: GPL-3.0-or-later
#
# For a description of the syntax of this configuration file, see
# Documentation/kbuild/kconfig-language.rst.

mainmenu "mkarchlinux Configuration"

config PACKAGES
	string packages
	default "base linux"
	help
	  The specified packages will be installed. If no packages are
	  specified to be installed, the base meta package will be installed.
	  
	  Whitespace separated list of packages to install.
	  
	  https://wiki.archlinux.org/index.php/installation_guide#Install_essential_packages

config EXTRA_KERNEL_CMDLINE
	string "extra kernel cmdline"
	default "console=tty1"
	help
	  Append extra kernel command-line parameters to bootloader.
	  
	  Whitespace separated list of kernel command-line parameters.
	  
	  https://www.kernel.org/doc/html/latest/admin-guide/kernel-parameters.html

config TIMEZONE
	string timezone
	default "America/Montreal"
	help
	  The time-zone to symlink to /etc/localtime.
	  
	  Filename relative to /usr/share/zoneinfo.
	  
	  https://wiki.archlinux.org/index.php/installation_guide#Time_zone

config LOCALES
	string locales
	default "en_CA.UTF-8 UTF-8:fr_CA.UTF-8 UTF-8:en_US.UTF-8 UTF-8"
	help
	  The locales to uncomment in /etc/locale.gen.
	  
	  Colon separated list of locales to generate.
	  
	  https://wiki.archlinux.org/index.php/installation_guide#Localization

config HOSTNAME
	string hostname
	default "archlinux"
	help
	  The hostname to set in /etc/hostname and entry to add in /etc/hosts.
	  
	  https://wiki.archlinux.org/index.php/installation_guide#Network_configuration

config IMAGE_SIZE
	string "Image Size"
	default "8G"
	help
	  Specify the image size in sectors. The number may be followed by the
	  multiplicative suffixes (KiB, MiB, GiB, TiB, PiB, EiB, ZiB and YiB),
	  then it's interpreted as size in bytes and the size is aligned
	  according to device I/O limits.

config READ_ONLY
	bool read-only
	select HAVE_VARIABLE_DATA_PARTITION

menu "GUID Partition Table"

config FORCE_PARTITIONS
	bool
	default y
	select HAVE_ROOT_PARTITION
	select HAVE_EFI_SYSTEM_PARTITION
	select HAVE_EXTENDED_BOOT_LOADER_PARTITION

config HAVE_ROOT_PARTITION
	bool "Root Partition"
	default "2G" if HAVE_HOME_PARTITION
	default ""
	help
	  Any native, optionally in LUKS.
	  
	  On systems with matching architecture, the first partition with this
	  type UUID on the disk containing the active EFI ESP is automatically
	  mounted to the root directory /. If the partition is encrypted with
	  LUKS or has dm-verity integrity data (see below), the device mapper
	  file will be named /dev/mapper/root.

config ROOT_PARTITION_SIZE
	string "Root Partition Size"
	default ""
	depends on HAVE_ROOT_PARTITION
	help
	  Specify the partition size in sectors. The number may be followed by
	  the multiplicative suffixes (KiB, MiB, GiB, TiB, PiB, EiB, ZiB and
	  YiB), then it's interpreted as size in bytes and the size is aligned
	  according to device I/O limits.

config ROOT_PARTITION_NAME
	string "Root Partition Name"
	default "rootfs"
	depends on HAVE_ROOT_PARTITION
	help

config HAVE_USR_PARTITION
	bool "/usr/ Partition"
	help
	  Any native, optionally in LUKS.
	  
	  Similar semantics to root partition, but just the /usr/ partition.

config USR_PARTITION_SIZE
	string "/usr/ Partition Size"
	default "2G"
	depends on HAVE_USR_PARTITION
	help
	  Specify the partition size in sectors. The number may be followed by
	  the multiplicative suffixes (KiB, MiB, GiB, TiB, PiB, EiB, ZiB and
	  YiB), then it's interpreted as size in bytes and the size is aligned
	  according to device I/O limits.

config USR_PARTITION_NAME
	string "/usr Partition Name"
	default "usr"
	depends on HAVE_USR_PARTITION
	help

config HAVE_HOME_PARTITION
	bool "Home Partition"
	help
	  Any native, optionally in LUKS.
	  
	  The first partition with this type UUID on the disk containing the
	  root partition is automatically mounted to /home/. If the partition
	  is encrypted with LUKS, the device mapper file will be named
	  /dev/mapper/home.

config HOME_PARTITION_SIZE
	string "Home Partition Size"
	default ""
	depends on HAVE_HOME_PARTITION
	help
	  Specify the partition size in sectors. The number may be followed by
	  the multiplicative suffixes (KiB, MiB, GiB, TiB, PiB, EiB, ZiB and
	  YiB), then it's interpreted as size in bytes and the size is aligned
	  according to device I/O limits.

config HOME_PARTITION_NAME
	string "Home Partition Name"
	default "home"
	depends on HAVE_HOME_PARTITION
	help

config HAVE_SERVER_DATA_PARTITION
	bool "Server Data Partition"
	help
	  Any native, optionally in LUKS.
	  
	  The first partition with this type UUID on the disk containing the
	  root partition is automatically mounted to /srv/. If the partition is
	  encrypted with LUKS, the device mapper file will be named
	  /dev/mapper/srv.

config SERVER_DATA_PARTITION_SIZE
	string "Server Data Partition Size"
	default "2G"
	depends on HAVE_SERVER_DATA_PARTITION
	help

config SERVER_DATA_PARTITION_NAME
	string "Server Data Partition Name"
	default "var"
	depends on HAVE_SERVER_DATA_PARTITION
	help

config HAVE_VARIABLE_DATA_PARTITION
	bool "Variable Data Partition"
	help
	  Any native, optionally in LUKS.
	  
	  The first partition with this type UUID on the disk containing the
	  root partition is automatically mounted to /var/ — under the
	  condition that its partition UUID matches the first 128 bit of
	  HMAC-SHA256(machine-id, 0x4d21b016b53445c2a9fb5c16e091fd2d) (i.e. the
	  SHA256 HMAC hash of the binary type UUID keyed by the machine ID as
	  read from /etc/machine-id. This special requirement is made because
	  /var/ (unlike the other partition types listed here) is inherently
	  private to a specific installation and cannot possibly be shared
	  between multiple OS installations on the same disk, and thus should
	  be bound to a specific instance of the OS, identified by its machine
	  ID. If the partition is encrypted with LUKS, the device mapper file
	  will be named /dev/mapper/var.

config VARIABLE_DATA_PARTITION_SIZE
	string "Variable Data Partition Size"
	default "2G"
	depends on HAVE_VARIABLE_DATA_PARTITION

config VARIABLE_DATA_PARTITION_NAME
	string "Variable Data Partition Name"
	default "var"
	depends on HAVE_VARIABLE_DATA_PARTITION
	help

config HAVE_TEMPORARY_DATA_PARTITION
	bool "Temporary Data Partition"
	help
	  Any native, optionally in LUKS.
	  
	  The first partition with this type UUID on the disk containing the
	  root partition is automatically mounted to /var/tmp/. If the
	  partition is encrypted with LUKS, the device mapper file will be
	  named /dev/mapper/tmp. Note that the intended mount point is indeed
	  /var/tmp/, not /tmp/. The latter is typically maintained in memory
	  via tmpfs and does not require a partition on disk. In some cases it
	  might be desirable to make /tmp/ persistent too, in which case it is
	  recommended to make it a symlink or bind mount to /var/tmp/, thus not
	  requiring its own partition type UUID.

config TEMPORARY_DATA_PARTITION_SIZE
	string "Temporary Data Partition Size"
	default "2G"
	depends on HAVE_TEMPORARY_DATA_PARTITION
	help
	  Specify the partition size in sectors. The number may be followed by
	  the multiplicative suffixes (KiB, MiB, GiB, TiB, PiB, EiB, ZiB and
	  YiB), then it's interpreted as size in bytes and the size is aligned
	  according to device I/O limits.

config TEMPORARY_DATA_PARTITION_NAME
	string "Temporary Data Partition Name"
	default "tmp"
	depends on HAVE_TEMPORARY_DATA_PARTITION
	help

config HAVE_SWAP_PARTITION
	bool "Swap"
	help
	  Swap
	  
	  All swap partitions on the disk containing the root partition are
	  automatically enabled.

config SWAP_PARTITION_SIZE
	string "Partition Size"
	default "512M"
	depends on HAVE_SWAP_PARTITION
	help
	  Specify the partition size in sectors. The number may be followed by
	  the multiplicative suffixes (KiB, MiB, GiB, TiB, PiB, EiB, ZiB and
	  YiB), then it's interpreted as size in bytes and the size is aligned
	  according to device I/O limits.

config SWAP_PARTITION_NAME
	string "Partition Name"
	default "swap"
	depends on HAVE_SWAP_PARTITION
	help

config HAVE_EFI_SYSTEM_PARTITION
	bool "EFI System Partition"
	help
	  VFAT
	  
	  The ESP used for the current boot is automatically mounted to /efi/
	  (or /boot/ as fallback), unless a different partition is mounted
	  there (possibly via /etc/fstab, or because the Extended Boot Loader
	  Partition — see below — exists) or the directory is non-empty on the
	  root disk. This partition type is defined by the UEFI Specification.

config EFI_SYSTEM_PARTITION_SIZE
	string "EFI System Partition Size"
	default "260M"
	depends on HAVE_EFI_SYSTEM_PARTITION
	help
	  Specify the partition size in sectors. The number may be followed by
	  the multiplicative suffixes (KiB, MiB, GiB, TiB, PiB, EiB, ZiB and
	  YiB), then it's interpreted as size in bytes and the size is aligned
	  according to device I/O limits.

config EFI_SYSTEM_PARTITION_NAME
	string "EFI System Partition Name"
	default "esp"
	depends on HAVE_EFI_SYSTEM_PARTITION
	help

config HAVE_EXTENDED_BOOT_LOADER_PARTITION
	bool "Extended Boot Loader Partition"
	depends on HAVE_EFI_SYSTEM_PARTITION
	help
	  Typically VFAT
	  
	  The Extended Boot Loader Partition (XBOOTLDR) used for the current
	  boot is automatically mounted to /boot/, unless a different partition
	  is mounted there (possibly via /etc/fstab) or the directory is
	  non-empty on the root disk. This partition type is defined by the
	  Boot Loader Specification.

config EXTENDED_BOOT_LOADER_PARTITION_SIZE
	string "Extended Boot Loader Partition Size"
	default "200M"
	depends on HAVE_EXTENDED_BOOT_LOADER_PARTITION
	help
	  Specify the partition size in sectors. The number may be followed by
	  the multiplicative suffixes (KiB, MiB, GiB, TiB, PiB, EiB, ZiB and
	  YiB), then it's interpreted as size in bytes and the size is aligned
	  according to device I/O limits.

config EXTENDED_BOOT_LOADER_PARTITION_NAME
	string "Extended Boot Loader Partition Name"
	default "boot"
	depends on HAVE_EXTENDED_BOOT_LOADER_PARTITION
	help

config HAVE_OTHER_DATA_PARTITION
	bool "Other Data Partition"
	help
	  Any native, optionally in LUKS.
	  
	  No automatic mounting takes place for other Linux data partitions.
	  This partition type should be used for all partitions that carry
	  Linux file systems. The installer needs to mount them explicitly via
	  entries in /etc/fstab. Optionally, these partitions may be encrypted
	  with LUKS.

config OTHER_DATA_PARTITION_SIZE
	string "Other Data Partition Size"
	default "5G"
	depends on HAVE_OTHER_DATA_PARTITION
	help
	  Specify the partition size in sectors. The number may be followed by
	  the multiplicative suffixes (KiB, MiB, GiB, TiB, PiB, EiB, ZiB and
	  YiB), then it's interpreted as size in bytes and the size is aligned
	  according to device I/O limits.

config OTHER_DATA_PARTITION_NAME
	string "Other Data Partition Name"
	default "data"
	depends on HAVE_OTHER_DATA_PARTITION
	help

config OTHER_DATA_FILESYSTEM_MOUNTPOINT
	string "mountpoint"
	default "/data"
	help
	  The mountpoint where to mount the filesystem.
	  
	  Absolute path to set in fstab (second-field).

endmenu
```

## configs/full_defconfig
```kconfig
CONFIG_EXTRA_KERNEL_CMDLINE="console=ttyS0"
CONFIG_IMAGE_SIZE="14G"
CONFIG_READ_ONLY=y
CONFIG_ROOT_PARTITION_SIZE="2G"
CONFIG_HAVE_USR_PARTITION=y
CONFIG_HAVE_HOME_PARTITION=y
CONFIG_HAVE_SERVER_DATA_PARTITION=y
CONFIG_HAVE_TEMPORARY_DATA_PARTITION=y
CONFIG_HAVE_SWAP_PARTITION=y
CONFIG_HAVE_OTHER_DATA_PARTITION=y
```
